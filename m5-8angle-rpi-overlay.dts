/dts-v1/;
/plugin/;
/ {
	compatible = "brcm,bcm2835";
	fragment@0 {
		target = <&i2c1>;
		__overlay__ {
			#address-cells = <1>;
			#size-cells = <0>;

			m5_8angle: m5_8angle@43 {
				compatible = "m5stack,8angle";
				reg = <0x43>;
				status = "okay";
			};
		};
	};
};
